/**
 * @cliArgs --board "/ti/boards/MSP_EXP432E401Y" --product "simplelink_msp432e4_sdk@4.20.00.12"
 * @versions {"data":"2021010520","timestamp":"2021010520","tool":"1.7.0+1746","templates":null}
 */

/**
 * Import the modules used in this configuration.
 */
const ADC   = scripting.addModule("/ti/drivers/ADC", {}, false);
const ADC1  = ADC.addInstance();
const GPIO  = scripting.addModule("/ti/drivers/GPIO");
const GPIO1 = GPIO.addInstance();
const RTOS  = scripting.addModule("/ti/drivers/RTOS");
const UART  = scripting.addModule("/ti/drivers/UART", {}, false);
const UART1 = UART.addInstance();

/**
 * Write custom configuration values to the imported modules.
 */
ADC1.$name       = "CONFIG_ADC_0";
ADC1.adc.$assign = "ADC0";

GPIO1.$hardware = system.deviceData.board.components.D1;
GPIO1.$name     = "CONFIG_GPIO_LED_0";

RTOS.name = "FreeRTOS";

UART1.$name     = "CONFIG_UART_0";
UART1.$hardware = system.deviceData.board.components.XDS110UART;

/**
 * Pinmux solution for unlocked pins/peripherals. This ensures that minor changes to the automatic solver in a future
 * version of the tool will not impact the pinmux you originally saw.  These lines can be completely deleted in order to
 * re-solve from scratch.
 */
ADC1.adc.adcPin.$suggestSolution  = "boosterpack.26";
GPIO1.gpioPin.$suggestSolution    = "expansion.87";
UART1.uart.$suggestSolution       = "UART0";
UART1.uart.txPin.$suggestSolution = "expansion.76";
UART1.uart.rxPin.$suggestSolution = "expansion.74";
